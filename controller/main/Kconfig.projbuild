## controller/main/Kconfig.projbuild
```kconfig
menu "Cottage thermostat"
    config THERMO_SERVO_GPIO
        int "Servo signal GPIO (AtomS3 Lite rear G38)"
        range 0 48
        default 38
    config THERMO_AP_SSID
        string "Open bench access point SSID"
        default "CottageThermoBench"
    config THERMO_WIFI_SSID
        string "Optional LAN Wi-Fi SSID (blank = AP only)"
        default ""
    config THERMO_WIFI_PASSWORD
        string "LAN Wi-Fi password"
        default ""
    config THERMO_LIVE_BENCH
        bool "Enable physical output from thermostat engine (inert bench only)"
        default n
        help
            Default is simulation. Enabling still requires a fresh session arm,
            measured map and explicit observed-position synchronization.
            No encoder feedback exists; never restore motion on boot.
endmenu
```

## shared/thermo_link/Kconfig
```kconfig
menu "Cottage direct fallback (configure both devices)"
    config COTTAGE_ESPNOW
        bool "Enable paired ESP-NOW fallback (hardware validation required)"
        default n
    config COTTAGE_ESPNOW_PEER
        string "Other device STATION MAC (AA:BB:CC:DD:EE:FF)"
        depends on COTTAGE_ESPNOW
        default ""
    config COTTAGE_ESPNOW_KEY
        string "Shared random 128-bit key (32 hex digits; keep private)"
        depends on COTTAGE_ESPNOW
        default ""
endmenu
```

## touchscreen/main/Kconfig.projbuild
```kconfig
menu "Cottage room thermostat"
    config ROOM_NATIVE_DISPLAY
        bool "Native Waveshare ESP32-S3-Touch-LCD-4B display"
        default y
        help
            Use only on the confirmed 4B (480x480, 16 MB flash, octal PSRAM).
            External probe shares the board I2C bus on SDA47/SCL48.
    config ROOM_DISPLAY_ROTATE_180
        bool "Rotate display and touch 180 degrees"
        depends on ROOM_NATIVE_DISPLAY
        default n
    config ROOM_WIFI_SSID
        string "Legacy Wi-Fi SSID (optional migration only; use captive portal)"
        default ""
    config ROOM_WIFI_PASSWORD
        string "Legacy Wi-Fi password (optional migration only)"
        default ""
    config ROOM_CONTROLLER_URL
        string "Controller base URL (no trailing slash)"
        default "http://192.168.4.1"
    config ROOM_SENSOR
        int "Probe: 0=disabled, 1=SHT31 (0x44), 2=SHT4x (0x44), 3=BMP/BME280 test"
        range 0 3
        default 0
        help
            BMP280/BME280 temperature test auto-detects 0x76/0x77 and logs/displays temperature.
            Test readings are never reported to the thermostat controller.
    config ROOM_SDA
        int "External probe SDA (-1 until wiring is confirmed)"
        range -1 48
        default -1
    config ROOM_SCL
        int "External probe SCL (-1 until wiring is confirmed)"
        range -1 48
        default -1
endmenu
```

## touchscreen/sdkconfig.defaults
```kconfig
CONFIG_IDF_TARGET="esp32s3"
CONFIG_ESP_CONSOLE_USB_SERIAL_JTAG=y
CONFIG_ESPTOOLPY_FLASHSIZE_16MB=y
CONFIG_ESPTOOLPY_FLASHMODE_QIO=y
CONFIG_PARTITION_TABLE_CUSTOM=y
CONFIG_PARTITION_TABLE_CUSTOM_FILENAME="partitions.csv"
CONFIG_SPIRAM=y
CONFIG_SPIRAM_MODE_OCT=y
CONFIG_SPIRAM_SPEED_80M=y
CONFIG_SPIRAM_FETCH_INSTRUCTIONS=y
CONFIG_SPIRAM_RODATA=y
CONFIG_ESP_DEFAULT_CPU_FREQ_MHZ_240=y
CONFIG_ESP32S3_DATA_CACHE_LINE_64B=y
CONFIG_FREERTOS_HZ=1000
CONFIG_LV_COLOR_DEPTH_16=y
CONFIG_LV_FONT_MONTSERRAT_14=y
CONFIG_LV_FONT_MONTSERRAT_16=y
CONFIG_LV_FONT_MONTSERRAT_20=y
CONFIG_LV_FONT_MONTSERRAT_24=y
CONFIG_LV_FONT_MONTSERRAT_28=y
CONFIG_LV_FONT_MONTSERRAT_48=y
CONFIG_LV_USE_DEMO_WIDGETS=n
CONFIG_LV_USE_DEMO_MUSIC=n
CONFIG_LV_USE_SYSMON=n
CONFIG_ROOM_NATIVE_DISPLAY=y
CONFIG_MBEDTLS_CERTIFICATE_BUNDLE=y
CONFIG_ESP_MAIN_TASK_STACK_SIZE=16384
# The RGB display needs internal DMA RAM; allocate TLS buffers in the 4B PSRAM.
CONFIG_MBEDTLS_EXTERNAL_MEM_ALLOC=y

CONFIG_LV_USE_BAR=y
CONFIG_LV_USE_SLIDER=y

CONFIG_BOOTLOADER_APP_ROLLBACK_ENABLE=y
# A bounded external-RAM LVGL arena avoids exhausting its old 64 KiB pool.
CONFIG_LV_MEM_SIZE_KILOBYTES=256
```
